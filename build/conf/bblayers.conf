## build/conf/bblayers.conf
```bitbake
# POKY_BBLAYERS_CONF_VERSION is increased each time build/conf/bblayers.conf
# changes incompatibly
POKY_BBLAYERS_CONF_VERSION = "2"

BBPATH = "${TOPDIR}"
BBFILES ?= ""

BBLAYERS ?= " \
  /home/ilm1tp/workspace/picam/poky/meta \
  /home/ilm1tp/workspace/picam/poky/meta-poky \
  /home/ilm1tp/workspace/picam/poky/meta-yocto-bsp \
  /home/ilm1tp/workspace/picam/meta-raspberrypi \
  /home/ilm1tp/workspace/picam/meta-openembedded/meta-oe \
  /home/ilm1tp/workspace/picam/meta-openembedded/meta-python \
  /home/ilm1tp/workspace/picam/meta-openembedded/meta-networking \
  /home/ilm1tp/workspace/picam/meta-openembedded/meta-webserver \
  /home/ilm1tp/workspace/picam/meta-openembedded/meta-multimedia \
  "
```
